VERSION ""

NS_ :

BS_:

BU_:

BO_ 3221225472 VECTOR__INDEPENDENT_SIG_MSG: 0 Vector__XXX
 SG_ send : 0|8@1- (1,0) [0|0] "" Vector__XXX

BO_ 1 response_message: 8 Vector__XXX
 SG_ response_unused : 63|8@1- (1,0) [0|0] "" Vector__XXX
 SG_ response_PID : 63|8@1- (1,0) [0|0] "" Vector__XXX
 SG_ response_mode : 56|8@1- (1,0) [0|0] "" Vector__XXX
 SG_ response_Dh : 48|8@1- (1,0) [0|0] "" Vector__XXX
 SG_ response_Ch : 40|8@1- (1,0) [0|0] "" Vector__XXX
 SG_ response_Bh : 32|8@1- (1,0) [0|0] "" Vector__XXX
 SG_ response_Ah : 24|8@1- (1,0) [0|0] "" Vector__XXX
 SG_ response_DLC : 16|6@1- (1,0) [0|0] "" Vector__XXX
 SG_ response_id : 0|11@1- (1,0) [0|0] "" Vector__XXX

BO_ 0 request_message: 8 Vector__XXX
 SG_ request_DLC : 63|8@1- (1,0) [0|0] "" Vector__XXX
 SG_ request_unused : 63|8@1- (1,0) [0|0] "" Vector__XXX
 SG_ request_PID : 63|8@1- (1,0) [0|0] "" Vector__XXX
 SG_ request_mode : 48|8@1- (1,0) [0|0] "" Vector__XXX
 SG_ request_Dh : 40|8@1- (1,0) [0|0] "" Vector__XXX
 SG_ request_Ch : 32|8@1- (1,0) [0|0] "" Vector__XXX
 SG_ request_Bh : 24|8@1- (1,0) [0|0] "" Vector__XXX
 SG_ request_Ah : 16|8@1- (1,0) [0|0] "" Vector__XXX
 SG_ request_id : 0|11@1- (1,0) [0|0] "" Vector__XXX

CM_ BO_ 3221225472 "This is a message for not used signals, created by Vector CANdb++ DBC OLE DB Provider.";
