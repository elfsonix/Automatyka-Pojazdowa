/*@!Encoding:1250*/
includes
{
  
}

variables
{
  msTimer startTimer1;
  msTimer startTimer2;
}

on start
{
  //setTimer(startTimer1, 1000);
  //setTimerCyclic(startTimer2, 2000);
}

on timer startTimer1
{
  message Request rqst;
  rqst.Request_ID = 0x0E;
  rqst.Request_DLC = 0x02;
  rqst.Request_0 = 0x01;
  output(rqst);
}

on sysvar MySpace::MyButton
{
  if(sysGetVariableInt(sysvar::MySpace::MyButton) == 1)
  {
      message Request rqst;
      rqst.Request_ID = 0x0D;
      rqst.Request_DLC = 0x02;
      rqst.Request_0 = 0x01;
      output(rqst);
  }
}

on timer startTimer2
{
  message Request rqst;
  rqst.Request_ID = 0x0D;
  rqst.Request_DLC = 0x02;
  rqst.Request_0 = 0x01;
  output(rqst);
}

on message Response
{
  if(this.Response_ID == 0x0D)
  {
    write("Velocity = %d", this.Response_1);
    sysSetVariableInt(sysvar::MySpace::Velocity, this.Response_1);
  }
}