/*@!Encoding:1250*/
includes
{
}

variables
{
}

on sysvar send
{
  message request_message Request;
  sysSetVariableString(sysvar::request_id,"7DF");
  sysSetVariableString(sysvar::request_mode, "01");
  sysSetVariableString(sysvar::request_PID, "0D");
  sysSetVariableString(sysvar::request_DLC, "02");
  sysSetVariableString(sysvar::request_Ah, "55");
  sysSetVariableString(sysvar::request_Bh, "55");
  sysSetVariableString(sysvar::request_Ch, "55");
  sysSetVariableString(sysvar::request_Dh, "55");
  sysSetVariableString(sysvar::request_unused, "55");
  output(Request);
}