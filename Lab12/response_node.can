/*@!Encoding:1250*/
includes
{
  
}

variables
{
  
}

on message request_message
{
  message response_message Response;
  Response.response_id = 
  Response.response_DLC = this.request_DLC;
  Response.response_mode = this.request_mode + 100;
  Response.response_PID = this.request_PID;
  Response.response_Ah= 170;
  Response.response_Bh= 0xaa;
  Response.response_Ch= 0xaa;
  Response.response_Dh= 0xaa;
  
  output(Response);
}
