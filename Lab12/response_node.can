/*@!Encoding:1250*/
includes
{
  
}

variables
{
  
}

on message request_message
{
  message response_message Response;
  Response.response_id = this.request_id;
  Response.response_DLC = this.request_DLC;
  Response.response_mode = this.request_mode;
  Response.response_PID = this.request_PID;
  Response.response_Ah= this.request_Ah;
  Response.response_Bh= this.request_Bh;
  Response.response_Ch= this.request_Ch;
  Response.response_Dh= this.request_Dh;
  Response.response_unused= this.request_unused;
  
  output(Response);
}
