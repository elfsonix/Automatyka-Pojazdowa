/*@!Encoding:1250*/
includes
{
  
}

variables
{
  
}

on message request_message
{
  message response_message Response;
  sysSetVariableString(sysvar::response_ID,"7E8");
  sysSetVariableString(sysvar::response_mode, "41");
  sysSetVariableString(sysvar::response_PID, "0D");
  sysSetVariableString(sysvar::response_DLC, "03");
  sysSetVariableString(sysvar::response_Ah, "32");
  sysSetVariableString(sysvar::response_Bh, "aa");
  sysSetVariableString(sysvar::response_Ch, "aa");
  sysSetVariableString(sysvar::response_Dh, "aa");
  sysSetVariableString(sysvar::response_unused, "aa");
}
