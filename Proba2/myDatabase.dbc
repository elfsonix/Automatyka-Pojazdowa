VERSION ""

NS_ :

BS_:

BU_:

BO_ 1 Signal_Message: 4 Vector__XXX
 SG_ Signal_y : 16|10@1- (1,0) [0|0] "" Vector__XXX
 SG_ Signal_x : 0|10@1- (1,0) [-512|511] "" Vector__XXX

BO_ 0 Connection_Message: 2 Vector__XXX
 SG_ AIsConnected : 8|8@1- (1,0) [0|0] "" Vector__XXX
 SG_ BIsConnected : 0|8@1- (1,0) [0|0] "" Vector__XXX
