VERSION ""

NS_ :

BS_:

BU_:

BO_ 3221225472 VECTOR__INDEPENDENT_SIG_MSG: 0 Vector__XXX
 SG_ Signal_x : 0|32@1- (1,0) [-3.4E+038|3.4E+038] "" Vector__XXX

BO_ 3 Output: 2 Vector__XXX
 SG_ Y : 0|32@1- (1,0) [-3.4E+038|3.4E+038] "" Vector__XXX

BO_ 2 Signal_Message_Y: 6 Vector__XXX
 SG_ Signal_yy : 32|32@1- (1,0) [-3.4E+038|3.4E+038] "" Vector__XXX

BO_ 1 Signal_Message_X: 4 Vector__XXX
 SG_ Signal_y : 16|32@1- (1,0) [-3.4E+038|3.4E+038] "" Vector__XXX
 SG_ Signal_x : 32|32@1- (1,0) [-3.4E+038|3.4E+038] "" Vector__XXX

BO_ 0 Connection_Message: 2 Vector__XXX
 SG_ AIsConnected : 8|8@1- (1,0) [0|0] "" Vector__XXX
 SG_ BIsConnected : 0|8@1- (1,0) [0|0] "" Vector__XXX

CM_ BO_ 3221225472 "This is a message for not used signals, created by Vector CANdb++ DBC OLE DB Provider.";
SIG_VALTYPE_ 3221225472 Signal_x : 1;
SIG_VALTYPE_ 3 Y : 1;
SIG_VALTYPE_ 2 Signal_yy : 1;
SIG_VALTYPE_ 1 Signal_y : 1;
SIG_VALTYPE_ 1 Signal_x : 1;
