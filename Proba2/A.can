/*@!Encoding:1250*/
includes
{
}

variables
{
  float x;
  mstimer connectionTimer;
  msTimer messageTimer;
}

on start
{
  setTimer(connectionTimer, 10);
  setTimer(messageTimer,100);
  x =0;
}

on message Connection_Message
{
  if(this.BIsConnected) write ("A & B connected");
}

on timer connectionTimer
{
  message Connection_Message A_connected;
  A_connected.AIsConnected = 1;
  output(A_connected);
}

on timer messageTimer{
  message Signal_Message_X msg_x;
  x +=1;
  msg_x.Signal_x = x;
  output(msg_x);
  setTimer(messageTimer, 100);
}

on message Signal_Message_y{
  message Output y;
  y.Y = this.Signal_y;
  output(y);
}