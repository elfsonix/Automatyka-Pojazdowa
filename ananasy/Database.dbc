VERSION ""

NS_ :

BS_:

BU_:

BO_ 1 Connection_message: 1 Vector__XXX
 SG_ IsConnectedB : 1|1@1+ (1,0) [0|1] "" Vector__XXX
 SG_ IsConnectedA : 0|1@1+ (1,0) [0|1] "" Vector__XXX

BO_ 256 Signal_message: 4 Vector__XXX
 SG_ y : 16|10@1- (1,0) [-512|511] "" Vector__XXX
 SG_ x : 0|10@1+ (1,0) [0|1023] "" Vector__XXX
