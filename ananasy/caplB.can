/*@!Encoding:1250*/
includes
{
  
}

variables
{
 
  message Connection_mesasage connection;
  int signal_x;
  double signal_y;
  message Signal_message msg_y;
}

on message Connection_mesasage
{
  connection.IsConnected = 1;
  output(connection);
}

on message Signal_message
{
  signal_x = this.x;
  signal_y = sin(signal_x)*cos(signal_x/20);
  msg_y.y = signal_y;
  output(msg_y);
}