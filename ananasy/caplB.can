/*@!Encoding:1250*/
includes
{
  
}

variables
{
 
  message Connection_message connected;
  int signal_x;
  double signal_y;
  message Signal_message msg_y;
}

on message Connection_message
{
  connected.IsConnectedB = 1;
  output(connected);
}

on message Signal_message
{
  signal_x = this.x;
  signal_y = sin(signal_x)*cos(signal_x/20);
  msg_y.y= signal_y;
  output(msg_y);
}