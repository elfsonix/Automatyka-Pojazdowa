 /*@!Encoding:1250*/
includes
{
  
}

variables
{
  int signal_x=1;
  double signal_y;
  message Connection_mesasage connection;
  message Signal_message msg_x;
  
  msTimer timer1;
  msTimer connection_timer;
}

on start
{
  setTimer(connection_timer, 10);
  setTimer(timer1,100);
}

on timer timer1
{
  setTimer(timer1,100);
  signal_x+=1;
  msg_x.x = signal_x;
  output(msg_x);
}
on timer connection_timer
{
  setTimer(connection_timer, 10);
  connection.IsConnectedA = 1;
  output(connection);
}

on message Connection_mesasage
{
  if(this.IsConnectedB)
  {
    write("A & B connected");
  }
}

on message Signal_message
{
  write("%f",this.y);
}