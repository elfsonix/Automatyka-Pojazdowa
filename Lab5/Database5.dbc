VERSION ""

NS_ :

BS_:

BU_:

BO_ 0 ThrottleMsg: 8 Vector__XXX
 SG_ ThrottleValue : 32|32@1- (1,0) [-3.4E+038|3.4E+038] "" Vector__XXX
 SG_ ThrottleRawValue : 0|32@1- (1,0) [-3.4E+038|3.4E+038] "" Vector__XXX

BO_ 1 EngineMsg: 8 Vector__XXX
 SG_ EngineSpeedRawValue : 32|32@1- (1,0) [-3.4E+038|3.4E+038] "" Vector__XXX
 SG_ EngineSpeedValue : 0|32@1- (1,0) [-3.4E+038|3.4E+038] "" Vector__XXX

SIG_VALTYPE_ 0 ThrottleValue : 1;
SIG_VALTYPE_ 0 ThrottleRawValue : 1;
SIG_VALTYPE_ 1 EngineSpeedRawValue : 1;
SIG_VALTYPE_ 1 EngineSpeedValue : 1;
